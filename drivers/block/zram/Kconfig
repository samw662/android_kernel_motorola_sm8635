## drivers/block/zram/Kconfig
```kconfig
# SPDX-License-Identifier: GPL-2.0
config ZRAM
	tristate "Compressed RAM block device support"
	depends on BLOCK && SYSFS && MMU
	depends on CRYPTO_LZO || CRYPTO_ZSTD || CRYPTO_LZ4 || CRYPTO_LZ4HC || CRYPTO_842
	select ZSMALLOC
	help
	  Creates virtual block devices called /dev/zramX (X = 0, 1, ...).
	  Pages written to these disks are compressed and stored in memory
	  itself. These disks allow very fast I/O and compression provides
	  good amounts of memory savings.

	  It has several use cases, for example: /tmp storage, use as swap
	  disks and maybe many more.

	  See Documentation/admin-guide/blockdev/zram.rst for more information.

config ZRAM_MOTO_SWAP
	bool "Build zram as moto_swap"
	depends on ZRAM=m
	help
	  Build the native zram driver as moto_swap.ko for devices whose
	  vendor initialization loads that module name. Only one zram
	  provider is built.

choice
	prompt "Default zram compressor"
	default ZRAM_DEF_COMP_LZORLE
	depends on ZRAM

config ZRAM_DEF_COMP_LZORLE
	bool "lzo-rle"
	depends on CRYPTO_LZO

config ZRAM_DEF_COMP_ZSTD
	bool "zstd"
	depends on CRYPTO_ZSTD

config ZRAM_DEF_COMP_LZ4
	bool "lz4"
	depends on CRYPTO_LZ4

config ZRAM_DEF_COMP_LZO
	bool "lzo"
	depends on CRYPTO_LZO

config ZRAM_DEF_COMP_LZ4HC
	bool "lz4hc"
	depends on CRYPTO_LZ4HC

config ZRAM_DEF_COMP_842
	bool "842"
	depends on CRYPTO_842

endchoice

config ZRAM_DEF_COMP
	string
	default "lzo-rle" if ZRAM_DEF_COMP_LZORLE
	default "zstd" if ZRAM_DEF_COMP_ZSTD
	default "lz4" if ZRAM_DEF_COMP_LZ4
	default "lzo" if ZRAM_DEF_COMP_LZO
	default "lz4hc" if ZRAM_DEF_COMP_LZ4HC
	default "842" if ZRAM_DEF_COMP_842

config ZRAM_WRITEBACK
       bool "Write back incompressible or idle page to backing device"
       depends on ZRAM
       help
	 With incompressible page, there is no memory saving to keep it
	 in memory. Instead, write it out to backing device.
	 For this feature, admin should set up backing device via
	 /sys/block/zramX/backing_dev.

	 With /sys/block/zramX/{idle,writeback}, application could ask
	 idle page's writeback to the backing device to save in memory.

	 See Documentation/admin-guide/blockdev/zram.rst for more information.

config HYBRIDSWAP_CORE
	bool "Motorola HybridSwap for zram"
	depends on BROKEN
	depends on ARM64_4K_PAGES
	depends on ZRAM && MEMCG && ANDROID_VENDOR_HOOKS && SCSI_UFSHCD
	select HYBRIDSWAP
	select HYBRIDSWAP_SWAPD
	help
	  Add Motorola's compressed extent writeback and background reclaim
	  to the native zram driver. Backing storage must be a direct
	  physical UFS partition reserved for swap. A zram device with
	  native writeback configured cannot also use HybridSwap.

config HYBRIDSWAP
	bool

config HYBRIDSWAP_SWAPD
	bool

config ZRAM_MEMORY_TRACKING
	bool "Track zRam block status"
	depends on ZRAM && DEBUG_FS
	help
	  With this feature, admin can track the state of allocated blocks
	  of zRAM. Admin could see the information via
	  /sys/kernel/debug/zram/zramX/block_state.

	  See Documentation/admin-guide/blockdev/zram.rst for more information.
```

## drivers/mmi_relay/Kconfig
```kconfig
# SPDX-License-Identifier: GPL-2.0-only

config MMI_RELAY
	tristate "Motorola relay support for fingerprint events"
	depends on INPUT
	help
	  Enable the Motorola relay interface used by the Goodix fingerprint
	  driver. The relay driver is built as an external module on CTWO.
```

## drivers/moto_sched/Kconfig
```kconfig
# SPDX-License-Identifier: GPL-2.0

config MOTO_FUTEX_INHERIT
    tristate "futex inherit"
    depends on SCHED_MOTO_UNFAIR && BROKEN
    default n
    help
      Boost the futex owner for the blocked UX thread. This requires the
      missing futex task state and synchronized holder lifetime handling.

config MOTO_RWSEM_INHERIT
    tristate "rwsem inherit"
    depends on SCHED_MOTO_UNFAIR
    default n
    help
      boost rwsem owner for the blocked ux thread.

config MOTO_MUTEX_INHERIT
    tristate "mutex inherit"
    depends on SCHED_MOTO_UNFAIR
    default n
    help
      boost mutex owner for the blocked ux thread.

config MOTO_ENABLE_MDPF
    tristate "Enable moto dynamic performance feature"
    depends on SCHED_MOTO_UNFAIR
    default n
    help
      This feature will allow the scheduler to maintain more detailed
      mvp scheduling of MDPF tasks (uclmap inheritance).
```

## drivers/watchdogtest/Kconfig
```kconfig
# SPDX-License-Identifier: GPL-2.0-only
config MOTO_WATCHDOG_TEST
	tristate "Motorola watchdog reset tests"
	depends on DEBUG_FS && QCOM_WDT_CORE
	help
	  Provide root-only debugfs controls for deliberately triggering a
	  Qualcomm hardware watchdog bite or a soft lockup. Loading the module
	  does not run a test. Leave this disabled on production kernels.
```

## vendor/qcom/opensource/audio-kernel/Kconfig
```kconfig
# SPDX-License-Identifier: GPL-2.0-only

menu "Qualcomm external audio modules"
	depends on ARCH_QCOM
	# Pineapple's external audio profile supplies SoundWire and codec modules;
	# CTWO does not enable the in-tree SoundWire controller.

config SND_SOC_PINEAPPLE
	tristate "Qualcomm Pineapple audio machine driver"
	depends on ARCH_PINEAPPLE
	help
	  Build the external Pineapple audio machine module.

config SND_SOC_WSA884X
	tristate "Qualcomm WSA884x external codec"

config SND_SOC_WCD9XXX_V2
	tristate "Qualcomm WCD9xxx v2 external codec core"

config SND_SOC_WCD937X
	tristate "Qualcomm WCD937x external codec"

config SND_SOC_WCD937X_SLAVE
	tristate "Qualcomm WCD937x external slave codec"
	depends on SND_SOC_WCD937X

config SND_SOC_WCD938X_SLAVE
	tristate "Qualcomm WCD938x external slave codec"

config SND_SOC_WCD939X
	tristate "Qualcomm WCD939x external codec"

config SND_SOC_WCD939X_SLAVE
	tristate "Qualcomm WCD939x external slave codec"
	depends on SND_SOC_WCD939X

config SND_SWR_HAPTICS
	tristate "Qualcomm SoundWire external haptics"

config SND_SOC_MSM_STUB
	tristate "Qualcomm external audio stub codec"

config SND_SOC_MSM_HDMI_CODEC_RX
	tristate "Qualcomm external HDMI receiver codec"

config SND_SOC_SWR_DMIC
	tristate "Qualcomm external SoundWire digital microphones"

endmenu
```

## vendor/qcom/opensource/securemsm-kernel/Kconfig
```kconfig
# SPDX-License-Identifier: GPL-2.0-only

config QSEECOM
	tristate "Qualcomm QSEECom external module"
	depends on ARCH_QCOM && QCOM_SCM
	help
	  Build the Qualcomm secure execution environment communication
	  driver as an external module.
```
